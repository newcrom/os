## build/conf/bblayers.conf
```bitbake
# POKY_BBLAYERS_CONF_VERSION is increased each time build/conf/bblayers.conf
# changes incompatibly
POKY_BBLAYERS_CONF_VERSION = "2"

BBPATH = "${TOPDIR}"
BBFILES ?= ""

BBLAYERS ?= " \
  /home/ssm-user/os/sources/poky/meta \
  /home/ssm-user/os/sources/poky/meta-poky \
  /home/ssm-user/os/sources/poky/meta-yocto-bsp \
  /home/ssm-user/os/sources/meta-openembedded/meta-oe \
  /home/ssm-user/os/sources/meta-openembedded/meta-python \
  /home/ssm-user/os/sources/meta-openembedded/meta-networking \
  /home/ssm-user/os/sources/meta-openembedded/meta-multimedia \
  /home/ssm-user/os/sources/meta-openembedded/meta-filesystems \
  /home/ssm-user/os/sources/meta-virtualization \
  /home/ssm-user/os/sources/meta-raspberrypi \
  /home/ssm-user/os/sources/meta-rauc \
  /home/ssm-user/os/sources/meta-rauc-raspberrypi \
  "
```
